## Projetos/03-Sensor-umidade-bateria/batery-sensor/main/Kconfig.projbuild
```kconfig
menu "Example Configuration"
    config BME280_SDA_GPIO
	int "bme280 sda gpio"
        default 19
	help
	    SDA gpio used to communicate with sensor via i2c

    config BME280_SCL_GPIO
        int "bme280 scl gpio"
        default 20
	help
	    SCL gpio used to communicate with sensor via i2c

    config ESP_WIFI_SSID
	string "Wifi SSID"
	help
	    SSID of wifi network to be used

    config ESP_WIFI_PASS
	string "Wifi Password"
	help
	    Password of wifi network to be used

    config ESP_MQTT_URL
        string "Mqtt url"
        help
            Mqtt url using format: mqtt://ip_address:port_number

    config ESP_MQTT_USER
        string "MQTT user"
        help
            User used For MQTT authentication.

    config ESP_MQTT_PASS
        string "MQTT password"
        help
            User password used in authentication.
endmenu
```

## Projetos/06-Monitoramento-porta/monitor-porta-aberta/main/Kconfig.projbuild
```kconfig
menu "Example Configuration"
    config GPIO_DOOR
	int "door sensor gpio"
        default 21
	help
	    door sensor gpio used to monitor the door

    config GPIO_BUZZER
        int "buzzer gpio"
        default 19
	help
	    buzzer gpio to excite the alarm buzzer

    config DOOR_ACTIVE_HIGH
        int "door sensor activation level high"
        default 1
	help
	    door sensor activation level: high = 1, low = 0

    config DOOR_DEBOUNCE_MS
        int "debounce time in ms"
        default 30
	help
	    Estabilization time em ms

    config OPEN_ALARM_SEC
        int "Aperture time in seconds"
        default 60
	help
	    Aperture time in seconds

    config ESP_WIFI_SSID
	string "Wifi SSID"
	help
	    SSID of wifi network to be used

    config ESP_WIFI_PASS
	string "Wifi Password"
	help
	    Password of wifi network to be used

    config ESP_MQTT_URL
        string "Mqtt url"
        help
            Mqtt url using format: mqtt://ip_address:port_number

    config ESP_MQTT_USER
        string "MQTT user"
        help
            User used For MQTT authentication.

    config ESP_MQTT_PASS
        string "MQTT password"
        help
            User password used in authentication.
endmenu
```

## Projetos/07-Quali-Enchimento/qc-enchimento/main/Kconfig.projbuild
```kconfig
menu "Example Configuration"
    config GPIO_TRIG
	int "HC-SR04 trigger gpio"
        default 21
	help
	    trigger gpio pin to communicate with HC-SR04 sensor 

    config GPIO_ECHO
        int "HC-SR04 echo gpio"
        default 19
	help
	    echo gpio pin to communicate with HC-SR04 sensor 

    config GPIO_LED
        int "LED gpio"
        default 2
	help
	   gpio pin used to drive the LED 

    config GPIO_RELE
        int "RELAY gpio"
        default 15
	help
	   gpio pin used to drive the Relay 

    config ESP_WIFI_SSID
	string "Wifi SSID"
	help
	    SSID of wifi network to be used

    config ESP_WIFI_PASS
	string "Wifi Password"
	help
	    Password of wifi network to be used

    config ESP_MQTT_URL
        string "Mqtt url"
        help
            Mqtt url using format: mqtt://ip_address:port_number

    config ESP_MQTT_USER
        string "MQTT user"
        help
            User used For MQTT authentication.

    config ESP_MQTT_PASS
        string "MQTT password"
        help
            User password used in authentication.
endmenu
```

## Projetos/09-Monit-Consumo/monit-energia/main/Kconfig.projbuild
```kconfig
menu "Example Configuration"
    config ESP_WIFI_SSID
	string "Wifi SSID"
	help
	    SSID of wifi network to be used

    config ESP_WIFI_PASS
	string "Wifi Password"
	help
	    Password of wifi network to be used

    config ESP_MQTT_URL
        string "Mqtt url"
        help
            Mqtt url using format: mqtt://ip_address:port_number

    config ESP_MQTT_USER
        string "MQTT user"
        help
            User used For MQTT authentication.

    config ESP_MQTT_PASS
        string "MQTT password"
        help
            User password used in authentication.
endmenu
```
